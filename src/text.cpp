// Copyright (c) 2022 Trevor Makes

#include "main.hpp"

#include "core/util.hpp"

extern const uint8_t CHAR_ROM[] PROGMEM;

constexpr uint8_t SCREEN_COLS = 8;
constexpr uint8_t SCREEN_ROWS = 8;
constexpr uint8_t COLS_PER_CHAR = 8;
constexpr uint8_t ROWS_PER_CHAR = 8;
constexpr uint8_t BITMAP_ROWS = SCREEN_ROWS * ROWS_PER_CHAR;
constexpr char FIRST_CHAR = '!';
constexpr char LAST_CHAR = '~';

extern uint8_t BITMAP_RAM[];

void draw_string(uint8_t row, const char* str) {
  uint8_t* col_ptr = BITMAP_RAM + row * SCREEN_COLS;
  uint8_t rows = util::min(ROWS_PER_CHAR, uint8_t(BITMAP_ROWS - util::min(BITMAP_ROWS, row)));

  // Clear line
  memset(col_ptr, 0, SCREEN_COLS * rows);

  for (uint8_t col = 0; col < SCREEN_COLS; ++col) {
    // Read ASCII code for current character
    char c = *str++;

    // End early if we find end of string
    if (c == '\0')
      break;

    // Skip non-printable characters
    if (c < FIRST_CHAR || c > LAST_CHAR)
      continue;

    // Trace each character fully before advancing to next character
    uint16_t char_index = (c - FIRST_CHAR) * ROWS_PER_CHAR;
    const uint8_t* char_ptr = &CHAR_ROM[char_index];
    for (uint8_t offset = col; offset < SCREEN_COLS * rows; offset += SCREEN_COLS) {
      col_ptr[offset] = pgm_read_byte(char_ptr++);
    }
  }
}

void clear_bitmap() {
  memset(BITMAP_RAM, 0, SCREEN_COLS * BITMAP_ROWS);
}

// Clear each row of screen buffer
void clear_screen(Args) {
  clear_bitmap();
  g_idle_fn = bitmap_idle;
}

// Copy logo to screen buffer
IdleFn init_logo() {
  clear_bitmap();
  draw_string(2 * ROWS_PER_CHAR, "````````");
  draw_string(3 * ROWS_PER_CHAR, "Trevor  ");
  draw_string(4 * ROWS_PER_CHAR, "  Makes!");
  draw_string(5 * ROWS_PER_CHAR, "````````");
  return bitmap_idle;
}

// Scroll screen buffer and print message to bottom row
void print_message(Args args) {
  const char* message = args.next();

  // Scroll rows up from the bottom
  memmove(BITMAP_RAM, BITMAP_RAM + SCREEN_COLS * ROWS_PER_CHAR, (SCREEN_ROWS - 1) * SCREEN_COLS * ROWS_PER_CHAR);

  // Copy message into now vacant line at bottom
  draw_string((SCREEN_ROWS - 1) * ROWS_PER_CHAR, message);

  // Set idle function to draw screen buffer
  g_idle_fn = bitmap_idle;
}

static uint8_t g_idle_count = 0;
static uint8_t g_scroll_count = 0;

void maze_idle() {
  // Limit scrolling to 1/8 framerate
  if ((g_idle_count++ & 0x07) == 0) {
    static char maze_chars[SCREEN_COLS];
    // Refresh random chars when scrolling a new row
    if (g_scroll_count++ == 0) {
      for (uint8_t i = 0; i < SCREEN_COLS; ++i) {
        maze_chars[i]  = random(2) ? '/' : '\\';
      }
    }
    // Scroll line up by one pixel
    memmove(BITMAP_RAM, BITMAP_RAM + SCREEN_COLS, (BITMAP_ROWS - 1) * SCREEN_COLS);
    draw_string(BITMAP_ROWS - g_scroll_count, maze_chars);
    if (g_scroll_count == ROWS_PER_CHAR) g_scroll_count = 0;
  }
  // Delegate to bitmap idle function
  bitmap_idle();
}

IdleFn init_maze() {
  g_idle_count = 0;
  g_scroll_count = 0;
  return maze_idle;
}

// Commodore 64 font extracted from VICE
// The 8x8 character data is stored in read-only program memory to save RAM.
// The characters are in ASCII order starting at 0x20 (space), with each
// character occupying 8 bytes. Each byte represents a row of pixels and each
// bit represents a pixel in that row, as in the character 'A':
// ...##... 0x18
// ..####.. 0x3C
// .##..##. 0x66
// .######. 0x7E
// .##..##. 0x66
// .##..##. 0x66
// .##..##. 0x66
// ........ 0x00
const uint8_t CHAR_ROM[] PROGMEM = {
  0x18, 0x18, 0x18, 0x18, 0x00, 0x00, 0x18, 0x00, // !
  0x66, 0x66, 0x66, 0x00, 0x00, 0x00, 0x00, 0x00, // "
  0x66, 0x66, 0xFF, 0x66, 0xFF, 0x66, 0x66, 0x00, // #
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  0x22, 0x77, 0x7F, 0x7F, 0x3E, 0x1C, 0x08, 0x00, // ♥ (replaces ~)
};
