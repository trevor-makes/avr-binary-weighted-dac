// Copyright (c) 2022 Trevor Makes

#include "main.hpp"

extern const uint8_t CHAR_ROM[] PROGMEM;

constexpr uint8_t SCREEN_COLS = 8;
constexpr uint8_t SCREEN_ROWS = 4;
constexpr uint8_t ROWS_PER_CHAR = 8;
constexpr uint8_t PIXELS_PER_ROW = 2;
constexpr char FIRST_CHAR = ' ';
constexpr char LAST_CHAR = 'z';

void draw_string(uint8_t y, const char* str) {
  for (uint8_t col = 0; col < SCREEN_COLS * BITS_PER_BYTE; col += BITS_PER_BYTE) {
    // Read ASCII code for current character
    char c = *str++;

    // End early if we find end of string
    if (c == '\0')
      break;

    // Skip non-printable characters
    if (c < FIRST_CHAR || c > LAST_CHAR)
      continue;

    // Trace each character fully before advancing to next character
    uint16_t offset = (c - FIRST_CHAR) * ROWS_PER_CHAR;
    const uint8_t* char_ptr = &CHAR_ROM[offset];
    uint8_t row_start = y * PIXELS_PER_ROW;
    uint8_t row_end = row_start + ROWS_PER_CHAR * PIXELS_PER_ROW;
    for (uint8_t row = row_start; row < row_end; /*++row*/) {
      // Look-up scan data for character at current row
      uint8_t char_data = pgm_read_byte(char_ptr++);//&CHAR_ROM[offset + row]);

      // Repeat each row to double pixels vertically
      for (uint8_t row_pixel = 0; row_pixel < PIXELS_PER_ROW; ++row_pixel) {
        write_bits(col, row++, char_data);
      }
    }
  }
}

// Character buffer for text messages
char SCREEN_RAM[SCREEN_ROWS][SCREEN_COLS];

// Draw each row of screen buffer
void draw_screen() {
  for (uint8_t row = 0; row < SCREEN_ROWS; ++row) {
    draw_string(row * ROWS_PER_CHAR, SCREEN_RAM[row]);
  }
}

// Clear each row of screen buffer
void clear_screen(Args) {
  for (uint8_t row = 0; row < SCREEN_ROWS; ++row) {
    SCREEN_RAM[row][0] = '\0';
  }
  idle_fn = draw_screen;
}

// Copy logo to screen buffer
void init_logo(Args) {
  strncpy(SCREEN_RAM[0], "````````", SCREEN_COLS);
  strncpy(SCREEN_RAM[1], "Trevor  ", SCREEN_COLS);
  strncpy(SCREEN_RAM[2], "  Makes!", SCREEN_COLS);
  strncpy(SCREEN_RAM[3], "````````", SCREEN_COLS);
  idle_fn = draw_screen;
}

// Scroll screen buffer and print message to bottom row
void print_message(Args args) {
  const char* message = args.next();

  // Copy line [1] to [0], line [2] to [1], and so on to scroll up
  for (uint8_t row = 1; row < SCREEN_ROWS; ++row) {
    strncpy(SCREEN_RAM[row - 1], SCREEN_RAM[row], SCREEN_COLS);
  }

  // Copy message into now vacant line at bottom
  strncpy(SCREEN_RAM[SCREEN_ROWS - 1], message, SCREEN_COLS);

  // Set idle function to draw screen buffer
  idle_fn = draw_screen;
}

// Commodore 64 font extracted from VICE
// The 8x8 character data is stored in read-only program memory to save RAM.
// The characters are in ASCII order starting at 0x20 (space), with each
// character occupying 8 bytes. Each byte represents a row of pixels and each
// bit represents a pixel in that row, as in the character 'A':
// ...##... 0x18
// ..####.. 0x3C
// .##..##. 0x66
// .######. 0x7E
// .##..##. 0x66
// .##..##. 0x66
// .##..##. 0x66
// ........ 0x00
const uint8_t CHAR_ROM[] PROGMEM = {
  0x00, 0x00, 0x00, 0x00, 0x00, 0x00, 0x00, 0x00, // space
  0x18, 0x18, 0x18, 0x18, 0x00, 0x00, 0x18, 0x00, // !
  0x66, 0x66, 0x66, 0x00, 0x00, 0x00, 0x00, 0x00, // "
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  0x00, 0x00, 0x7E, 0x0C, 0x18, 0x30, 0x7E, 0x00, // z
  // ASCII characters {|}~ are not present
};
