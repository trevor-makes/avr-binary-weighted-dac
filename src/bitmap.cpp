// Copyright (c) 2022 Trevor Makes

#include "main.hpp"

#include "core/mon.hpp"

#include <EEPROM.h>

constexpr uint8_t BITMAP_ROWS = DAC::Y::RESOLUTION;
constexpr uint8_t BITMAP_COL_BITS = DAC::X::RESOLUTION;
constexpr uint8_t BITS_PER_BYTE = 8;
constexpr uint8_t BITMAP_COL_BYTES = BITMAP_COL_BITS / BITS_PER_BYTE;
constexpr size_t BITMAP_BYTES = BITMAP_ROWS * BITMAP_COL_BYTES;

uint8_t BITMAP_RAM[BITMAP_BYTES];

static uint8_t g_pixel_hold = 3;

void set_delay(Args args) {
  g_pixel_hold = atoi(args.next());
}

template <bool FLIP_H>
void write_bits(uint8_t x, const uint8_t y, uint8_t bits) {
  // Skip blank scanlines
  if (bits == 0) return;

  // Write Y only if we find a non-blank scanline
  DAC::Y::write(y);

  // Write X for each set bit
  do {
    if (FLIP_H) --x; // Pre-decrement if reversed
    if (bits & 0x80) {
      DAC::X::write(x); // Draw if MSB set
      delayMicroseconds(g_pixel_hold);
    }
    if (!FLIP_H) ++x; // Post-decrement if forwards
  } while ((bits <<= 1) > 0); // Shift next bit into MSB
}

// Trace set bitmap pixels with X and Y
template <bool FLIP_H, bool FLIP_V>
void draw_bitmap() {
  const uint8_t* bitmap_ptr = BITMAP_RAM;
  // For row in [0, BITMAP_ROWS), reversed if FLIP_V set
  for (uint8_t row = FLIP_V ? BITMAP_ROWS : 0; ; ) {
    // Pre-decrement row if reversed
    if (FLIP_V) {
      if (row == 0) break;
      --row;
    }
    // For col in [0, BITMAP_ROWS), reversed if FLIP_H set
    for (uint8_t col = FLIP_H ? BITMAP_COL_BITS : 0; ; ) {
      write_bits<FLIP_H>(col, row, *bitmap_ptr++);
      // Post-increment/decrement col
      if (FLIP_H) {
        col -= BITS_PER_BYTE;
        if (col == 0) break;
      } else {
        col += BITS_PER_BYTE;
        if (col == BITMAP_COL_BITS) break;
      }
    }
    // Post-increment row if forwards
    if (!FLIP_V) {
      ++row;
      if (row == BITMAP_ROWS) break;
    }
  }
}

bool g_flip_v = true;
bool g_flip_h = true;

void bitmap_idle() {
  if (g_flip_h) {
    if (g_flip_v) {
      draw_bitmap<true, true>();
    } else {
      draw_bitmap<true, false>();
    }
  } else {
    if (g_flip_v) {
      draw_bitmap<false, true>();
    } else {
      draw_bitmap<false, false>();
    }
  }
}

void flip_vertical(Args) {
  g_flip_v = !g_flip_v;
}

void flip_horizontal(Args) {
  g_flip_h = !g_flip_h;
}

void copy_bitmap(const uint8_t* source) {
  memcpy_P(BITMAP_RAM, source, BITMAP_BYTES);
}

struct API : public core::mon::Base<API, 0> {
  static StreamEx& get_stream() { return g_serial_ex; }
  static uint8_t read_byte(uint16_t addr) { return BITMAP_RAM[addr]; }
  static void write_byte(uint16_t addr, uint8_t data) { BITMAP_RAM[addr % BITMAP_BYTES] = data; }
};

void export_bitmap(Args) {
  core::mon::impl_export<API>(0, BITMAP_BYTES);
}

void import_bitmap(Args args) {
  core::mon::cmd_import<API>(args);
  g_idle_fn = bitmap_idle;
}

// save and load need the same validation and it's more convenient as a macro
#define VALIDATE_ADDRESS(NAME, ARGS) \
  uint16_t NAME; \
  { \
    uint8_t index = atoi(ARGS.next()); \
    if ((index + 1) * BITMAP_BYTES > EEPROM.length()) { \
      g_serial_ex.println("invalid index"); \
      return; \
    } \
    NAME = index * BITMAP_BYTES; \
  }

void save_bitmap(Args args) {
  VALIDATE_ADDRESS(address, args);
  EEPROM.put(address, BITMAP_RAM);
}

void load_bitmap(Args args) {
  VALIDATE_ADDRESS(address, args);
  EEPROM.get(address, BITMAP_RAM);
  g_idle_fn = bitmap_idle;
}

extern const uint8_t DOGE_ROM[] PROGMEM;
extern const uint8_t PEPE_ROM[] PROGMEM;
extern const uint8_t REEE_ROM[] PROGMEM;
extern const uint8_t WOJAK_ROM[] PROGMEM;

IdleFn init_doge() {
  copy_bitmap(DOGE_ROM);
  return bitmap_idle;
}

IdleFn init_pepe() {
  copy_bitmap(PEPE_ROM);
  return bitmap_idle;
}

IdleFn init_reee() {
  copy_bitmap(REEE_ROM);
  return bitmap_idle;
}

IdleFn init_wojak() {
  copy_bitmap(WOJAK_ROM);
  return bitmap_idle;
}

// 64x64 1-bit doge.png
const uint8_t DOGE_ROM[BITMAP_BYTES] PROGMEM = {
  0x00, 0x00, 0x00, 0x00, 0x00, 0x00, 0x00, 0x00,
  0x00, 0x00, 0x08, 0x00, 0x00, 0x00, 0x00, 0x00,
  0x00, 0x00, 0x1C, 0x00, 0x00, 0x00, 0x00, 0x00,
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  0x03, 0xFF, 0xFD, 0xFF, 0xFF, 0xFF, 0xFF, 0xFE,
};

// 64x64 1-bit pepe.png
const uint8_t PEPE_ROM[BITMAP_BYTES] PROGMEM = {
  0x00, 0x00, 0x00, 0x00, 0x00, 0x00, 0x00, 0x00,
  0x00, 0x00, 0x00, 0x00, 0x00, 0x00, 0x00, 0x00,
  0x00, 0x00, 0x00, 0x00, 0x00, 0x00, 0x00, 0x00,
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  0x00, 0x00, 0x00, 0x00, 0x00, 0x00, 0x00, 0x00,
};

// 64x64 1-bit reee.png
const uint8_t REEE_ROM[BITMAP_BYTES] PROGMEM = {
  0x00, 0x00, 0x00, 0x00, 0x00, 0x00, 0x00, 0x00,
  0x00, 0x00, 0x01, 0x40, 0x00, 0x00, 0x00, 0x00,
  0x00, 0x00, 0x0F, 0xF8, 0x00, 0x14, 0x00, 0x00,
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  0xFF, 0xFF, 0xFF, 0x7F, 0xFF, 0xFF, 0x3F, 0xC0,
};

// 64x64 1-bit wojak.png
const uint8_t WOJAK_ROM[BITMAP_BYTES] PROGMEM = {
  0x00, 0x00, 0x00, 0x00, 0x00, 0x00, 0x00, 0x00,
  0x00, 0x00, 0x00, 0x00, 0x00, 0x00, 0x00, 0x00,
  0x00, 0x00, 0x00, 0xFF, 0xFE, 0x00, 0x00, 0x00,
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  0x03, 0xFF, 0xFF, 0xFF, 0xFF, 0xFF, 0xFF, 0x00,
};
